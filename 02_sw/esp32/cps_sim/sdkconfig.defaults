## 02_sw/vendor/vela_sifli/boards/sf32lb52/drivers/gnss/Kconfig
```kconfig
#
# u-blox MAX-M10S-00B-01 GNSS on UART2
# (PA31 MCU TX / PA32 MCU RX / PA43 GNSS_PWR = module VCC)
#

config BOARD_L96_GNSS
	bool "u-blox MAX-M10S-00B-01 GNSS (board UART2)"
	default n
	depends on BSP_USING_UART2
	select GNSSUTILS_MINMEA_LIB
	---help---
		Enable MAX-M10S-00B-01 GNSS on USART2 (/dev/ttyS0).
		MCU PA32 receives GNSS_TX; MCU PA31 drives GNSS_RX.
		PA43 is GNSS_PWR (module VCC). USART2 stays open and
		polls like the NSH console UART. Official low power is
		cutting module VCC, not closing the host UART. Use NSH
		"test gnss" to read NMEA.

if BOARD_L96_GNSS

config BOARD_L96_GNSS_DEVPATH
	string "GNSS UART device path"
	default "/dev/ttyS0"
	---help---
		USART2 is registered as /dev/ttyS0 when USART1 is the console.

config BOARD_L96_GNSS_BAUD
	int "GNSS UART baud rate"
	default 38400
	---help---
		M10 ROM default is 38400 8N1 NMEA. MAX-M10S-00B-01 OTP may
		fuse 9600; use 9600 if RX is garbage at 38400.

config BOARD_L96_GNSS_PWR_ACTIVE_HIGH
	bool "GNSS_PWR is active high"
	default n
	---help---
		N (default): drive PA43 low to power the module (P-MOS / inverted enable).
		Y: drive PA43 high to power the module.

config BOARD_L96_GNSS_PWR_DELAY_MS
	int "Power-on settle time (milliseconds)"
	default 1000
	---help---
		Delay after asserting GNSS_PWR before the module UART is used.

config BOARD_L96_GNSS_PWR_OFF_MS
	int "Power-off hold time (milliseconds)"
	default 2500
	---help---
		Active-low GNSS_PWR stays high this long during a restart so
		the MAX-M10S-00B-01 rail can fall. 500 ms is often too short
		after a forced off (test iowrite / brownout). Do not close
		USART2 for this: official low power is cutting VCC only.

config MYVENDOR_GNSS_LOG
	bool "GNSS UART / eph / idle extra logs"
	default n
	---help---
		Event INFO logs: MAX-M10S-00B-01 VCC cycle, idle sleep/wake,
		poll timeout runs, eph inject progress, first PVT frame dump.
		These only fire on state changes, so they can stay on while
		soaking. Steady-state per-frame telemetry moved to
		MYVENDOR_GNSS_TRACE.

config MYVENDOR_GNSS_TRACE
	bool "GNSS steady-state per-frame telemetry (noisy)"
	default n
	---help---
		Diagnostic/steady-state logs, printed at DEBUG level: 1 Hz
		publish (valid/sats/q/speed), per-frame PVT (gSpeed/sAcc), 5 s
		link / link cpu / link extra window dump, poll_to run counter.
		Healthy output is identical line after line and fills the
		console ring within a minute, hiding the event that matters.
		Off by default and compiled out entirely (macro expands to
		nothing) - turn on only when the numbers themselves are the
		thing under investigation. Diag files only keep WARN+, so
		these never reach /mnt/kv/diag either way.

endif # BOARD_L96_GNSS
```

## 02_sw/vendor/vela_sifli/boards/sf32lb52/drivers/lcd/Kconfig
```kconfig
#
# For a description of the syntax of this configuration file,
# see the file kconfig-language.txt in the NuttX tools repository.
#

menuconfig SIFLI_LCD
    bool "SiFli Display Driver"
    default n

if SIFLI_LCD
    config LCD_USING_ILI8688E
        bool
        default n

    config BSP_LCDC_USING_SPI_NODCX_1DATA
        def_bool n 
    config BSP_LCDC_USING_SPI_NODCX_2DATA
        def_bool n 
    config BSP_LCDC_USING_SPI_DCX_1DATA
        def_bool n 
    config BSP_LCDC_USING_SPI_DCX_2DATA
        def_bool n 
    config BSP_LCDC_USING_QADSPI
        def_bool n 
    config BSP_LCDC_USING_DBI
        def_bool n 
    config BSP_LCDC_USING_DSI
        def_bool n
    config BSP_LCDC_USING_DPI
        def_bool n
    config BSP_USING_RAMLESS_LCD
        def_bool n
    config BSP_LCDC_USING_JDI_PARALLEL
        def_bool n

    config LCD_USING_PWM_AS_BACKLIGHT
        def_bool n

    config BSP_LCDC1_USE_LCDC2_TE
        def_bool n

    config BSP_USE_LCDC2_ON_HPSYS
        def_bool n

    config BSP_USING_ROUND_TYPE_LCD
        def_bool n

    config BSP_USING_RECT_TYPE_LCD
        def_bool n



    choice
        prompt "Select LCD"
        default LCD_USING_NV3031A

        config LCD_USING_ED_LB55BILI8688E
            bool "1.78 rect QAD-SPI LCD(ED-LB55DSI17801 - Green)"
            select LCD_USING_ILI8688E
            select TSC_USING_CST918 if BSP_USING_TOUCHD
            select BSP_LCDC_USING_QADSPI
            select BSP_USING_RECT_TYPE_LCD
            if LCD_USING_ED_LB55BILI8688E
               config LCD_ILI8688E_VSYNC_ENABLE
                    bool "Enable LCD VSYNC (TE signal)"
                    def_bool y
            endif

        config LCD_USING_CO5300
            bool "1.85 rect QSPI Single-Screen LCD(LCD_1P85_390*450_DevKit_Adapter_V1.0.0)"
            select BSP_LCDC_USING_QADSPI
            select LCD_USING_PWM_AS_BACKLIGHT
            select BSP_USING_RECT_TYPE_LCD
            if LCD_USING_CO5300
               config LCD_CO5300_VSYNC_ENABLE
                    bool "Enable LCD VSYNC (TE signal)"
                    def_bool y

                   config LCD_CO5300_BW_TEST_MODE
                    bool "Enable CO5300 Black/White Test On Boot"
                    default n
            endif

        config LCD_USING_ST7789S
            bool "SPI ST7789S TFT TK024F3036 (PA37-PA42, SPI2)"
            select BSP_USING_RECT_TYPE_LCD
            help
                后续剔除：Helm One 已改 NV3031A，不再使用 ST7789。
                本选项与 lcd_spi2 / st7789s_lcd / PA40 CS 路径仅作遗留，
                产品 defconfig 不要打开。
                TK024F3036 2.4" 320x240 ST7789S on dedicated SPI2 (lcd_spi2,
                not the generic sifli_spi bus driver):
                  PA37 MOSI, PA38 MISO, PA39 SCK,
                  PA40 CS, PA41 BL, PA42 DC
                Init sequence from vendor LCD.c.

        config LCD_USING_NV3031A
            bool "NV3031A-AI 240x320 4-bit QSPI TFT"
            select BSP_LCDC_USING_QADSPI
            select BSP_USING_LCDC
            select BSP_USING_RECT_TYPE_LCD
            help
                NV3031A-AI RGB565 panel on LCDC1 QAD-SPI (no TE):
                  PA00 RST, PA01 backlight PWM (GPTIM1 CH4, ~20% duty;
                  no series LED resistor on this board),
                  PA03 CS, PA04 SCK, PA05-PA08 D0-D3,
                  PA10 panel power (active-low).
                Init sequence from vendor TFT/lcd.c init_9c01().

    endchoice

    # 后续剔除：Helm One 已不用 ST7789，整段 ST7789S 选项可删。
    if LCD_USING_ST7789S
        config LCD_ST7789S_SOFTSPI
            bool "GPIO bit-bang SPI for ST7789S bring-up"
            default n
            help
                Drive PA37/39/40/42 as GPIO (SPI mode 3) instead of
                hardware SPI2. Use for timing debug; disable after SPI2 works.

        config LCD_ST7789S_SOFTSPI_HALF_US
            int "Soft-SPI half-bit delay (microseconds)"
            depends on LCD_ST7789S_SOFTSPI
            default 2
            range 0 50

        config LCD_ST7789S_SPI2_TX_DMA
            bool "DMA for LCD SPI2 pixel transfers (fb flush)"
            default y
            help
                Use HAL_SPI_Transmit_DMA in lcd_spi2 for bulk RGB565
                transfers (FBIO_UPDATE / st7789 putarea). The calling
                thread still blocks until DMA completes (sem wait in
                DMA IRQ callback chain); CPU is idle during the transfer.
                Small register/cmd traffic stays polling.

        config LCD_ST7789S_RGB_BOOT_TEST
            bool "Draw RGB bar test pattern on LCD boot"
            default n
            help
                When enabled, fill the panel with red/green/blue bars
                during board_lcd_initialize(). Disable for product
                firmware — the bicycle Startup splash replaces this.
    endif

    config LCD_HOR_RES_MAX
        int
        default 368 if LCD_USING_ED_LB55BILI8688E
        default 390 if LCD_USING_CO5300
        default 240 if LCD_USING_NV3031A
        default 320 if LCD_USING_ST7789S

        
    config LCD_VER_RES_MAX
        int
        default 448 if LCD_USING_ED_LB55BILI8688E
        default 450 if LCD_USING_CO5300
        default 320 if LCD_USING_NV3031A
        default 240 if LCD_USING_ST7789S


    config LCD_DPI
        int
        default 315 if LCD_USING_ED_LB55BILI8688E
        default 315 if LCD_USING_CO5300
        default 240 if LCD_USING_NV3031A
        default 240 if LCD_USING_ST7789S

endif
```

## 02_sw/vendor/vela_sifli/boards/sf32lb52/drivers/sensor/Kconfig
```kconfig
#
# Board-level BMP388 barometer (I2C1 on PA43/PA44)
#

comment "Enable Device Drivers -> Sensor Device Support (CONFIG_SENSORS) first"
	depends on !SENSORS && I2C && I2C_DRIVER

config BOARD_BMP388
	bool "Bosch BMP388 barometer (board I2C)"
	default n
	depends on SENSORS && I2C && I2C_DRIVER
	---help---
		Enable BMP388 driver on the board sensor I2C bus (I2C1 /dev/i2c0).
		Registers /dev/uorb/sensor_baro0 via the NuttX sensor framework.

if BOARD_BMP388

config BOARD_BMP388_I2C_ADDR
	hex "BMP388 I2C 7-bit address"
	default 0x76
	---help---
		0x76 when SDO is tied to GND; 0x77 when SDO is tied to VDDIO.

config BOARD_BMP388_I2C_FREQUENCY
	int "BMP388 I2C bus frequency"
	default 400000

endif # BOARD_BMP388

config BOARD_MMC5983MA
	bool "Memsic MMC5983MA magnetometer (board I2C)"
	default n
	depends on SENSORS && I2C && I2C_DRIVER
	---help---
		Enable MMC5983MA driver on the board sensor I2C bus (I2C1 /dev/i2c0).
		Registers /dev/uorb/sensor_mag0 via the NuttX sensor framework.

if BOARD_MMC5983MA

config BOARD_MMC5983MA_I2C_ADDR
	hex "MMC5983MA I2C 7-bit address"
	default 0x30

config BOARD_MMC5983MA_I2C_FREQUENCY
	int "MMC5983MA I2C bus frequency"
	default 400000

endif # BOARD_MMC5983MA

config BOARD_BMI270
	bool "Bosch BMI270 IMU (SF32LB52 board driver)"
	default n
	depends on SENSORS && I2C && I2C_DRIVER
	---help---
		Board-local BMI270 driver (drivers/sensor/sf32lb52_bmi270/).
		Registers /dev/uorb/sensor_accel0 and sensor_gyro0 on /dev/i2c0.

if BOARD_BMI270

config BOARD_BMI270_I2C_ADDR
	hex "BMI270 I2C 7-bit address"
	default 0x68
	---help---
		0x68 when SDO is tied to GND; 0x69 when SDO is tied to VDDIO.

config BOARD_BMI270_I2C_FREQUENCY
	int "BMI270 I2C bus frequency"
	default 400000

config BOARD_BMI270_POLL
	bool "BMI270 poll mode (kernel thread)"
	default n

if BOARD_BMI270_POLL

config BOARD_BMI270_POLL_INTERVAL
	int "BMI270 poll interval (microseconds)"
	default 100000

config BOARD_BMI270_THREAD_STACKSIZE
	int "BMI270 poll thread stack size"
	default 2048

endif # BOARD_BMI270_POLL

config BOARD_BMI270_LOAD_FROM_HEAP
	bool "Load BMI270 config file from heap"
	default n
	---help---
		Copy the 8 KiB ASIC configuration blob to heap before upload.
		Leave disabled to stream from flash (.rodata).

endif # BOARD_BMI270
```
